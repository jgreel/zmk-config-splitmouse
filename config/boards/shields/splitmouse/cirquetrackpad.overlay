// cirquetrackpad.overlay

#include "splitmouse.dtsi" // Notice that the main dtsi files are included in the overlay.

&default_kscan {
    row-gpios

        ;
};

&xiao_i2c0 {
	status = "okay";
	cirque_trackpad@2A {
		compatible = "cirque,pinnacle";
		reg = <0x2A>;
		label = "Cirque_Trackpad";
        dr-gpios = <&xiao_d	D3	GPIO_ACTIVE_HIGH>;
		//invert-x;
		//invert-y;
		//sleep;
		//no-taps;
	};
};