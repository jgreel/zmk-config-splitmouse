#include <behaviors.dtsi>
#include <dt-bindings/zmk/keys.h>
#include <dt-bindings/zmk/mouse.h>
#include <dt-bindings/zmk/bt.h>

/ {
    keymap {
        compatible = "zmk,keymap";
                // ROW A FROM SCHEMATIC FILE
                // ROW A FROM SCHEMATIC FILE
                // ROW A FROM SCHEMATIC FILE
        default_layer {
            bindings = <
                /*&mkp LCLK */
                &mkp RCLK
                &bt BT_CLR
                /*&mkp MCLK*/
           >;
        };
    };
};
