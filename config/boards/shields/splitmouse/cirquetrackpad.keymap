#include <behaviors.dtsi>
#include <dt-bindings/zmk/keys.h>
#include <dt-bindings/zmk/bt.h>
#include <dt-bindings/zmk/outputs.h>

/ {
    /*
    macros {
        /*ZMK_MACRO(ble_nxt,
            wait-ms = <1>;
            tap-ms = <1>;
            bindings = <&out OUT_BLE &bt BT_NXT>;
        )
    };
    */

    keymap {
        compatible = "zmk,keymap";

        default_layer {
                // ROW A FROM SCHEMATIC FILE
                // ROW A FROM SCHEMATIC FILE
                // ROW A FROM SCHEMATIC FILE
            bindings = <
                &bt BT_NXT      
                &bt BT_CLR      
                &out OUT_TOG    
           >;
        };
    };
};
