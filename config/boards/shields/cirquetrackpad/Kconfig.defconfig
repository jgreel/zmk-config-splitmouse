## config/boards/shields/cirquetrackpad/Kconfig.defconfig
```kconfig
if SHIELD_CIRQUETRACKPAD

config ZMK_KEYBOARD_NAME
    default "Cirque Trackpad"

config I2C
    default y

endif
```

## config/boards/shields/pimtrackball/Kconfig.defconfig
```kconfig
if SHIELD_PIMTRACKBALL

config ZMK_KEYBOARD_NAME
    default "Pim Trackball"

endif
```

## config/boards/shields/splitmouse/Kconfig.defconfig
```kconfig
if SHIELD_CIRQUETRACKPAD

config ZMK_KEYBOARD_NAME
    default "Split Mouse"

config ZMK_SPLIT_ROLE_CENTRAL
    default y

endif

if SHIELD_CIRQUETRACKPAD || SHIELD_PIMTRACKBALL

config ZMK_SPLIT
    default y

endif
```

## config/boards/shields/splitmouse/Kconfig.shield
```kconfig
config SHIELD_CIRQUETRACKPAD
    def_bool $(shields_list_contains,cirquetrackpad)

config SHIELD_PIMTRACKBALL
    def_bool $(shields_list_contains,pimtrackball)
```

## config/boards/shields/trackpadtrackball/Kconfig.defconfig
```kconfig
if SHIELD_CIRQUETRACKPAD

config ZMK_KEYBOARD_NAME
    default "Cirque Trackpad"

endif
```

## config/boards/shields/trackpadtrackball/Kconfig.shield
```kconfig
config SHIELD_CIRQUETRACKPAD
    def_bool $(shields_list_contains,cirquetrackpad)
```

## config/west.yml
```yaml
manifest:
  defaults:
    revision: v0.3
  remotes:
    - name: zmkfirmware
      url-base: https://github.com/zmkfirmware
    - name: jgreel
      url-base: https://github.com/jgreel
    - name: urob
      url-base: https://github.com/urob
    - name: petejohanson
      url-base: https://github.com/petejohanson/
    - name: halfdane
      url-base: https://github.com/halfdane/
    - name: oleksandrmaslov
      url-base: https://github.com/oleksandrmaslov     
    # Additional modules containing boards/shields/custom code can be listed here as well
  projects:
    - name: zmk
      remote: zmkfirmware
      import: app/west.yml
    #- name: cirque-input-module
    #  remote: petejohanson
    #  revision: main
    - name: zmk-input-gestures
      remote: halfdane
      revision: main
    # Add these if you want to use absolute mode:
    - name: zmk-input-processors
      remote: halfdane
      revision: main
    - name: cirque-input-module
      remote: halfdane
      revision: absolute_mode
    - name: zmk-pointing-acceleration
      remote: oleksandrmaslov
      revision: fixed
  self:
    path: config
```
