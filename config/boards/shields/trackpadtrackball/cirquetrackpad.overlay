// cirquetrackpad.overlay

#include "trackpadtrackball.dtsi" // Notice that the main dtsi files are included in the overlay.

&default_kscan {
    row-gpios

        ;
};

//```devicetree
&xiao_i2c {
	status = "okay";
	trackpad@2 {
		compatible = "cirque,pinnacle";
		reg = <0x2A>;
		label = "Cirque_Trackpad";
        dr-gpios = <&xiao_d	D3	GPIO_ACTIVE_HIGH>;
		//invert-x;
		//invert-y;
		//sleep;
		//no-taps;
	};
};
//```